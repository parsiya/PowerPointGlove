## esp_hid_glove/sdkconfig.defaults
```kconfig
CONFIG_BT_ENABLED=y
CONFIG_BTDM_CTRL_MODE_BTDM=y
CONFIG_BT_BLUEDROID_ENABLED=y
CONFIG_BT_CLASSIC_ENABLED=y
CONFIG_BT_BLE_ENABLED=y
CONFIG_BT_HID_ENABLED=y
CONFIG_BT_HID_DEVICE_ENABLED=y
CONFIG_BT_SDP_COMMON_ENABLED=y
CONFIG_BT_BLE_42_FEATURES_SUPPORTED=y
CONFIG_PARTITION_TABLE_SINGLE_APP_LARGE=y

# Custom options

# enable BLE
CONFIG_BT_NIMBLE_ENABLED=y
# Set the BLE GAP (Generic Access Profile) name - this is different from short name
CONFIG_BT_NIMBLE_SVC_GAP_DEVICE_NAME="PowerPoint Glove"

# Only one of these should be uncommented.

# mouse mode
# CONFIG_EXAMPLE_MOUSE_ENABLE=y
# CONFIG_EXAMPLE_HID_DEVICE_ROLE=3

# keyboard mode
CONFIG_EXAMPLE_KBD_ENABLE=y
CONFIG_EXAMPLE_HID_DEVICE_ROLE=2
```
